## components/beacon_device/Kconfig.projbuild
```kconfig
config BEACON_MAX_FONT_SIZE
    int "Maximum font pixel height to compile in"
    default 140
    range 0 255
    help
        Fonts taller than this are excluded from the auto-size registry
        and not linked into the binary. 0 excludes all fonts.

config BEACON_MIN_FONT_SIZE
    int "Minimum font pixel height to compile in"
    default 0
    range 0 255
    help
        Fonts shorter than this are excluded. 0 means no lower limit.

# Hidden symbol — exists only to pull in LVGL dependencies required by the
# beacon_device display consumers via Kconfig's select mechanism.
# Selects are conditional so only fonts within [MIN, MAX] are enabled.
config BEACON_DEVICE_LVGL_DEPS
    bool
    default y
    select LV_CONF_SKIP
    select LV_FONT_UNSCII_8
    select LV_FONT_MONTSERRAT_12 if BEACON_MAX_FONT_SIZE >= 12 && BEACON_MIN_FONT_SIZE <= 12
    select LV_FONT_MONTSERRAT_16 if BEACON_MAX_FONT_SIZE >= 16 && BEACON_MIN_FONT_SIZE <= 16
    select LV_FONT_MONTSERRAT_20 if BEACON_MAX_FONT_SIZE >= 20 && BEACON_MIN_FONT_SIZE <= 20
    select LV_FONT_MONTSERRAT_24 if BEACON_MAX_FONT_SIZE >= 24 && BEACON_MIN_FONT_SIZE <= 24
    select LV_FONT_MONTSERRAT_28 if BEACON_MAX_FONT_SIZE >= 28 && BEACON_MIN_FONT_SIZE <= 28
    select LV_FONT_MONTSERRAT_32 if BEACON_MAX_FONT_SIZE >= 32 && BEACON_MIN_FONT_SIZE <= 32
    select LV_FONT_MONTSERRAT_36 if BEACON_MAX_FONT_SIZE >= 36 && BEACON_MIN_FONT_SIZE <= 36
    select LV_FONT_MONTSERRAT_40 if BEACON_MAX_FONT_SIZE >= 40 && BEACON_MIN_FONT_SIZE <= 40
    select LV_FONT_MONTSERRAT_44 if BEACON_MAX_FONT_SIZE >= 44 && BEACON_MIN_FONT_SIZE <= 44
    select LV_FONT_MONTSERRAT_48 if BEACON_MAX_FONT_SIZE >= 48 && BEACON_MIN_FONT_SIZE <= 48
```

## satelites/CYD/CYD-Satelite/sdkconfig.defaults
```kconfig
CONFIG_ESPTOOLPY_FLASHSIZE_4MB=y
CONFIG_ESPTOOLPY_FLASHSIZE="4MB"

# Custom partition table needed for embedded TTF font
CONFIG_PARTITION_TABLE_CUSTOM=y
CONFIG_PARTITION_TABLE_CUSTOM_FILENAME="partitions.csv"

# Bump FreeRTOS tick to 1 ms so esp_lvgl_port 5 ms timer is accurate
CONFIG_FREERTOS_HZ=1000


# Color logs
CONFIG_BOOTLOADER_LOG_COLORS=y

# main task allocates SateliteOrchestrator + EspHttpServer on the stack and
# calls into LVGL during display init — 3584 bytes is not enough
CONFIG_ESP_MAIN_TASK_STACK_SIZE=8192
```

## satelites/Huidu/HD-WF2/sdkconfig.defaults
```kconfig
CONFIG_ESPTOOLPY_FLASHSIZE_8MB
CONFIG_ESPTOOLPY_FLASHSIZE="8MB"

# Custom partition table needed for embedded TTF font
CONFIG_PARTITION_TABLE_CUSTOM=y
CONFIG_PARTITION_TABLE_CUSTOM_FILENAME="partitions.csv"

# LVGL Configuration
CONFIG_LV_COLOR_DEPTH_16=y
CONFIG_LV_USE_PERF_MONITOR=n
CONFIG_LV_USE_MEM_MONITOR=n

# FreeRTOS Configuration
CONFIG_FREERTOS_HZ=1000

# Color logs 
CONFIG_BOOTLOADER_LOG_COLORS=y

# main task allocates SateliteOrchestrator + EspHttpServer on the stack and
# calls into LVGL during display init — 3584 bytes is not enough
# CONFIG_ESP_MAIN_TASK_STACK_SIZE=8192
```

## satelites/Synapt/Satelite-Pro/sdkconfig.defaults
```kconfig
CONFIG_ESPTOOLPY_FLASHSIZE_4MB=y
CONFIG_ESPTOOLPY_FLASHSIZE="4MB"

# Usb Serial
CONFIG_ESP_CONSOLE_USB_CDC=y
CONFIG_ESP32S2_KEEP_USB_ALIVE=y

# Custom partition table needed for embedded TTF font
CONFIG_PARTITION_TABLE_CUSTOM=y
CONFIG_PARTITION_TABLE_CUSTOM_FILENAME="partitions.csv"

# Use system malloc (ESP-IDF heap) instead of LVGL's 64 KB static DRAM pool
CONFIG_LV_USE_BUILTIN_MALLOC=n
CONFIG_LV_USE_CLIB_MALLOC=y

# Don't compile LVGL example files (they contain large static canvas buffers)
CONFIG_LV_BUILD_EXAMPLES=n

# Bump FreeRTOS tick to 1 ms so esp_lvgl_port 5 ms timer is accurate
CONFIG_FREERTOS_HZ=1000


# Color logs 
CONFIG_BOOTLOADER_LOG_COLORS=y
```
